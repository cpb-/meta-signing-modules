## conf/layer.conf
```bitbake
# We have a conf and classes directory, add to BBPATH
BBPATH .= ":${LAYERDIR}"

# We have recipes-* directories, add to BBFILES
BBFILES += "${LAYERDIR}/recipes-*/*/*.bb \
            ${LAYERDIR}/recipes-*/*/*.bbappend"

BBFILE_COLLECTIONS += "meta-my-secure-layer"
BBFILE_PATTERN_meta-my-secure-layer = "^${LAYERDIR}/"
BBFILE_PRIORITY_meta-my-secure-layer = "6"

LAYERDEPENDS_meta-my-secure-layer = "core"
LAYERSERIES_COMPAT_meta-my-secure-layer = "scarthgap"
```
